## config/boards/arm/dao/Kconfig.defconfig
```kconfig
# Copyright (c) 2021 Rafael Yumagulov
# SPDX-License-Identifier: MIT

config ZMK_COMBO_MAX_PRESSED_COMBOS
	default 8

config ZMK_COMBO_MAX_COMBOS_PER_KEY
	default 16

config ZMK_COMBO_MAX_KEYS_PER_COMBO
	default 8

if BOARD_DAO_LEFT

	config ZMK_KEYBOARD_NAME
	default "Dao"

    config ZMK_SPLIT_BLE_ROLE_CENTRAL
	default y

endif # BOARD_DAO_LEFT

if BOARD_DAO_RIGHT

	config ZMK_KEYBOARD_NAME
	default "Dao Right"

endif # BOARD_DAO_RIGHT


if BOARD_DAO_LEFT || BOARD_DAO_RIGHT

config BOARD
	default "dao"

config ZMK_SPLIT
	default y

config BT_CTLR
	default BT

config ZMK_BLE
	default y

config ZMK_USB
	default y

config ZMK_BATTERY_VOLTAGE_DIVIDER
	default y

if USB

config USB_NRFX
	default y

config USB_DEVICE_STACK
	default y

endif # USB

endif # BOARD_DAO_LEFT || BOARD_DAO_RIGHT
```
